## boards/shields/skeletyl_handwire/Kconfig.defconfig
```kconfig
if SHIELD_SKELETYL_HANDWIRE_LEFT

config ZMK_KEYBOARD_NAME
    default "Mill Skeletyl"

config ZMK_SPLIT_ROLE_CENTRAL
    default y

endif

if SHIELD_SKELETYL_HANDWIRE_LEFT || SHIELD_SKELETYL_HANDWIRE_RIGHT

config ZMK_SPLIT
    default y

endif
```

## boards/shields/skeletyl_handwire/Kconfig.shield
```kconfig
config SHIELD_SKELETYL_HANDWIRE_LEFT
    def_bool $(shields_list_contains,skeletyl_handwire_left)

config SHIELD_SKELETYL_HANDWIRE_RIGHT
    def_bool $(shields_list_contains,skeletyl_handwire_right)
```
